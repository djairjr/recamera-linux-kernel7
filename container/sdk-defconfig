## external/Config.in
```kconfig
# Configuration options of this br2-external tree (reCamera).

source "$BR2_EXTERNAL_RECAMERA_PATH/package/morse-driver/Config.in"
source "$BR2_EXTERNAL_RECAMERA_PATH/package/morse-cli/Config.in"
source "$BR2_EXTERNAL_RECAMERA_PATH/package/wpa-supplicant-s1g/Config.in"
source "$BR2_EXTERNAL_RECAMERA_PATH/package/sophgo-ion/Config.in"
source "$BR2_EXTERNAL_RECAMERA_PATH/package/sophgo-osdrv/Config.in"
source "$BR2_EXTERNAL_RECAMERA_PATH/package/sophgo-mpi/Config.in"
source "$BR2_EXTERNAL_RECAMERA_PATH/package/sophgo-cviruntime/Config.in"
source "$BR2_EXTERNAL_RECAMERA_PATH/package/recamera-firmware/Config.in"
source "$BR2_EXTERNAL_RECAMERA_PATH/package/recamera-fip/Config.in"
source "$BR2_EXTERNAL_RECAMERA_PATH/package/recamera-tests/Config.in"
source "$BR2_EXTERNAL_RECAMERA_PATH/package/recamera-app/Config.in"
```

## external/board/seeed/sg2002_recamera_emmc/boot.its
```
/dts-v1/;

/* Boot FIT for the Seeed reCamera (SG2002).
 *
 * The vendor U-Boot in the eMMC boot0 reads this image from the BOOT partition
 * and boots it with `bootm <addr>#config-sg2002_recamera_emmc' (the configuration
 * name is CVICHIP "_" CVIBOARD, i.e. "sg2002_recamera_emmc": see the board header
 * include/configs/cv181x-asic.h:200 and META/misc_info.txt of the official image).
 *
 * Keep in sync with the kernel build: CONFIG_KERNEL_ENTRY_HACK_ADDR of the vendor
 * SDK is 0x80200000, which is where the vendor U-Boot relocates the kernel.
 *
 * The kernel is gzip-compressed (Image.gz, compression = "gzip"): the BOOT partition
 * is 8192 KB and the raw Image is ~9 MB. The vendor build does the same
 * (build/Makefile: `${KERNEL_COMPRESS} -c -9 -f -k Image > Image.${KERNEL_COMPRESS}`
 * with KERNEL_GZIP as the default of the "Kernel Image compress algorithm" choice).
 *
 * No hash-N nodes: the mkimage that Buildroot builds for the host receives only
 * CONFIG_FIT and CONFIG_MKIMAGE_DTC_PATH, so NO hash algorithm is enabled — measured
 * here, a `hash-1 { algo = "sha256"; }` and a `hash-1 { algo = "crc32"; }` both abort
 * with "Unsupported hash algorithm (...) for 'hash-1' hash node in 'kernel' image node"
 * / "Can't add hashes to FIT blob: -93"; with no hash node at all the FIT is built and
 * boots. The u-boot template "Single kernel and FDT blob"
 * (docs.u-boot.org/en/latest/usage/fit/kernel_fdt.html) does carry crc32 + sha256, but
 * this host mkimage cannot compute them. For integrity: enable
 * BR2_PACKAGE_HOST_UBOOT_TOOLS_FIT_SIGNATURE_SUPPORT (uboot-tools.mk:148-150 adds
 * CONFIG_TOOLS_LIBCRYPTO=y to host-uboot-tools) and then add a sha256 hash node.
 */
/ {
	description = "reCamera (SG2002) kernel";
	#address-cells = <1>;

	images {
		kernel {
			description = "Linux 7.2 Image (gzip)";
			data = /incbin/("Image.gz");
			type = "kernel";
			arch = "riscv";
			os = "linux";
			compression = "gzip";
			load = <0x80200000>;
			entry = <0x80200000>;
		};

		fdt {
			description = "sg2002-recamera device tree";
			data = /incbin/("sg2002-recamera.dtb");
			type = "flat_dt";
			arch = "riscv";
			compression = "none";
		};
	};

	configurations {
		default = "config-sg2002_recamera_emmc";

		config-sg2002_recamera_emmc {
			description = "Seeed reCamera (SG2002, eMMC)";
			kernel = "kernel";
			fdt = "fdt";
		};
	};
};
```

## external/package/morse-cli/Config.in
```kconfig
config BR2_PACKAGE_MORSE_CLI
	bool "morse-cli (morse_cli)"
	select BR2_PACKAGE_LIBNL
	select BR2_PACKAGE_LIBUSB
	help
	  Morse Micro HaLow control tool, upstream release 1.14.1
	  (github.com/MorseMicro/morse_cli), the release of the driver.
```

## external/package/morse-driver/Config.in
```kconfig
config BR2_PACKAGE_MORSE_DRIVER
	bool "morse-driver (HaLow, Morse Micro MM610x)"
	depends on BR2_LINUX_KERNEL
	help
	  Morse Micro 802.11ah (Wi-Fi HaLow) driver for the optional reCamera
	  HaLow module (fgh100m, MM6108 over SDIO in the SD slot): morse.ko and
	  dot11ah.ko.  Source: upstream release 1.14.1
	  (github.com/MorseMicro/morse_driver, the release the vendor image
	  shipped), ported to Linux 7.2 by
	  0001-port-to-linux-7.2.patch.  Same kernel options as the vendor:
	  MORSE_SDIO, MORSE_USER_ACCESS, MORSE_VENDOR_COMMAND.

comment "morse-driver needs a Linux kernel"
	depends on !BR2_LINUX_KERNEL
```

## external/package/recamera-app/Config.in
```kconfig
config BR2_PACKAGE_RECAMERA_APP
	bool "recamera-app (recamerad and the recamera-* tools, Rust)"
	depends on BR2_PACKAGE_HOST_RUSTC_TARGET_ARCH_SUPPORTS
	depends on BR2_INSTALL_LIBSTDCPP # sophgo-cviruntime
	select BR2_PACKAGE_HOST_RUSTC
	select BR2_PACKAGE_SOPHGO_MPI
	select BR2_PACKAGE_SOPHGO_CVIRUNTIME
	select BR2_PACKAGE_OPENSSL # WebRTC (DTLS/SRTP)
	help
	  The reCamera application: the recamerad daemon (camera, YOLO
	  detection, streaming, configuration), from app/ of this tree.
	  docs/application.md.
```

## external/package/recamera-fip/Config.in
```kconfig
config BR2_PACKAGE_RECAMERA_FIP
	bool "recamera-fip (boot chain: official fip with patched OpenSBI)"
	help
	  The fip.bin the SG2002 ROM loads (FSBL + OpenSBI + U-Boot +
	  FreeRTOS), checked in as built: the official Seeed one
	  (fip-seeed-original.bin) with only its OpenSBI replaced by the
	  same vendor OpenSBI 0.9 plus the fence.tso emulation the T-Head
	  C906 needs. make-fip.sh rebuilds it from the vendor SDK.
	  Installed as images/fip.bin. See README.md here.
```

## external/package/recamera-firmware/Config.in
```kconfig
config BR2_PACKAGE_RECAMERA_FIRMWARE
	bool "recamera-firmware (Wi-Fi, Bluetooth and HaLow firmware)"
	help
	  The firmware the reCamera radios load, downloaded from their
	  public sources at pinned commits (sha256 checked):
	  - CYW43012 Wi-Fi (brcmfmac43012-sdio .bin/.clm_blob/.txt) and
	    Bluetooth (.hcd) from the Seeed reCamera trees;
	  - Morse Micro MM6108 HaLow firmware and the Quectel FGH100M
	    board configuration from MorseMicro/morse-firmware.
```

## external/package/recamera-tests/Config.in
```kconfig
config BR2_PACKAGE_RECAMERA_TESTS
	bool "recamera-tests (hardware/port check programs)"
	help
	  Small check programs of the port, from tests/ of this tree:
	  recamera-iontest (ION allocator), recamera-ioninfo (ION heap
	  usage), recamera-fencetso (does fence.tso survive on the C906).
	  The camera pipeline checks (recamera-vicap) come with sophgo-mpi.
```

## external/package/sophgo-cviruntime/Config.in
```kconfig
config BR2_PACKAGE_SOPHGO_CVIRUNTIME
	bool "sophgo-cviruntime (Sophgo TPU/NPU runtime)"
	depends on BR2_INSTALL_LIBSTDCPP
	select BR2_PACKAGE_SOPHGO_OSDRV
	help
	  The Sophgo NPU userspace for the SG2002 (cv181x): libcviruntime,
	  which loads .cvimodel files and runs them on the TPU through
	  /dev/cvi-tpu0, and libcvikernel, which builds the TPU commands.
	  See docs/multimedia.md §4.8.
```

## external/package/sophgo-ion/Config.in
```kconfig
config BR2_PACKAGE_SOPHGO_ION
	bool "sophgo-ion (ION allocator for the Sophgo multimedia stack)"
	depends on BR2_LINUX_KERNEL
	help
	  The vendor ION memory allocator of the Sophgo 5.10 kernel
	  (drivers/staging/android/ion), which mainline removed in 5.11,
	  built out of tree for Linux 7.2 as cvi_ion.ko: /dev/ion, the
	  carveout heap over the "ion" reserved-memory region, and the
	  cvi_ion_* API of the Sophgo osdrv modules.  F7, see
	  docs/multimedia.md.

comment "sophgo-ion needs a Linux kernel"
	depends on !BR2_LINUX_KERNEL
```

## external/package/sophgo-mpi/Config.in
```kconfig
config BR2_PACKAGE_SOPHGO_MPI
	bool "sophgo-mpi (Sophgo multimedia userspace: sys, vi, isp)"
	select BR2_PACKAGE_SOPHGO_OSDRV
	help
	  The Sophgo MPI libraries for the SG2002 (vendor cvi_mpi, cv181x):
	  libsys, libvi, libisp with the closed 3A algorithm objects
	  (musl build) and libcvi_bin. F7, see docs/multimedia.md.
```

## external/package/sophgo-osdrv/Config.in
```kconfig
config BR2_PACKAGE_SOPHGO_OSDRV
	bool "sophgo-osdrv (Sophgo multimedia kernel modules)"
	depends on BR2_LINUX_KERNEL
	select BR2_PACKAGE_SOPHGO_ION
	help
	  The Sophgo osdrv kernel modules for the SG2002 (cv181x): sys,
	  base, and, step by step, the MIPI-CSI receiver, VI/ISP, VPSS,
	  TPU and the codecs. Vendor osdrv/interdrv, built out of tree
	  for Linux 7.2. F7, see docs/multimedia.md.

comment "sophgo-osdrv needs a Linux kernel"
	depends on !BR2_LINUX_KERNEL
```

## external/package/wpa-supplicant-s1g/Config.in
```kconfig
config BR2_PACKAGE_WPA_SUPPLICANT_S1G
	bool "wpa-supplicant-s1g (HaLow)"
	select BR2_PACKAGE_LIBNL
	select BR2_PACKAGE_OPENSSL
	help
	  Morse Micro's wpa_supplicant for 802.11ah (wpa_supplicant_s1g,
	  wpa_cli_s1g), upstream release 1.14.1
	  (github.com/MorseMicro/hostap), the release of the driver.
```
